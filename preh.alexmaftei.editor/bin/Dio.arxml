AUTOSAR XML (schema 4-1-2)
package /arpackage
  module config DioConfig: definition=Dio
    DioGeneral: DioDevErrorDetect=false, DioVersionInfoApi=false, DioFlipChannelApi=false
    DioConfig
      7 x DioPort:
        DioPortE
          DIO_PE_0 (DioChannel): DioChannelId=0
          DIO_PE_1 (DioChannel): DioChannelId=1
        DioPortAD
          DIO_PAD_0 (DioChannel): DioChannelId=0
          DIO_PAD_1 (DioChannel): DioChannelId=1
        DioPortT
          DIO_PT_0 (DioChannel): DioChannelId=0
          DIO_PT_1 (DioChannel): DioChannelId=1
        DioPortP
          3 x DioChannel:
            DIO_PP_3: DioChannelId=3
            DIO_PP_5: DioChannelId=5
            DIO_PP_7: DioChannelId=7
        DioPortJ
        DioPortS
          4 x DioChannel:
            DIO_PS_3: DioChannelId=3
            DIO_PS_2: DioChannelId=2
            DIO_PS_0: DioChannelId=0
            DIO_PS_1: DioChannelId=1
        DioPortL
          DIO_PL_0 (DioChannel): DioChannelId=0
